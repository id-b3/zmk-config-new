## boards/shields/skeletyl/Kconfig.defconfig
```kconfig
if SHIELD_SKELETYL_LEFT || SHIELD_SKELETYL_RIGHT

# Enable split keyboard support by default
config ZMK_SPLIT
	default y

endif

# Settings specific to the left shield
if SHIELD_SKELETYL_LEFT

config ZMK_KEYBOARD_NAME
	default "Skeletyl Left"

endif

# Settings specific to the right shield
if SHIELD_SKELETYL_RIGHT

config ZMK_KEYBOARD_NAME
	default "Skeletyl Right"
config ZMK_SPLIT_ROLE_CENTRAL
  default y

endif
```
