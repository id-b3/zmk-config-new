// SPDX-License-Identifier: MIT
#include "skeletyl.dtsi" // Include common definitions

// Enable the right encoder defined in the .dtsi file
&right_encoder {
    status = "okay";
};

// Apply column offset for the right half in the matrix transform
&default_transform {
    col-offset = <5>; // Start right half keys at logical column 5
};

// Define the column pins for the right half matrix
&kscan0 {
    col-gpios
        = <&pro_micro 8  (GPIO_ACTIVE_HIGH | GPIO_PULL_DOWN)>
        , <&pro_micro 7  (GPIO_ACTIVE_HIGH | GPIO_PULL_DOWN)>
        , <&pro_micro 6  (GPIO_ACTIVE_HIGH | GPIO_PULL_DOWN)>
        , <&pro_micro 10 (GPIO_ACTIVE_HIGH | GPIO_PULL_DOWN)>
        , <&pro_micro 20 (GPIO_ACTIVE_HIGH | GPIO_PULL_DOWN)>
        ;
};
